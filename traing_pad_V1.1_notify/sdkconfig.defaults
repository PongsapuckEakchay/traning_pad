## traing_pad_V1.1_notify/sdkconfig.defaults
```kconfig
# Override some defaults so BT stack is enabled
CONFIG_BT_ENABLED=y
CONFIG_BTDM_CTRL_MODE_BLE_ONLY=y
CONFIG_BTDM_CTRL_MODE_BR_EDR_ONLY=n
CONFIG_BTDM_CTRL_MODE_BTDM=n

#
# Partition Table
#
# CONFIG_PARTITION_TABLE_SINGLE_APP is not set
CONFIG_PARTITION_TABLE_TWO_OTA=y
# CONFIG_PARTITION_TABLE_CUSTOM is not set
# end of Partition Table

CONFIG_ESPTOOLPY_FLASHSIZE_4MB=y

CONFIG_BT_BLUEDROID_ENABLED=y
```
